/*
 * Copyright (c) 2020 The ZMK Contributors
 *
 * SPDX-License-Identifier: MIT
 */

/ {
	behaviors {
		stn: behavior_steno {
			compatible = "zmk,behavior-steno";
			#binding-cells = <1>;
		};
	};
};
