## app/boards/arm/fissure/Kconfig.board
```kconfig
config BOARD_FISSURE_RIGHT
	bool "fissure right"
	depends on SOC_NRF52840_QIAA

config BOARD_FISSURE_LEFT
	bool "fissure left"
	depends on SOC_NRF52840_QIAA
```

## app/boards/arm/fissure/Kconfig.defconfig
```kconfig
if BOARD_FISSURE_LEFT || BOARD_FISSURE_RIGHT

config BOARD
	default "fissure"

config ZMK_KEYBOARD_NAME
	default "Fissure v3.3"

config SOC_DCDC_NRF52X_HV
    default y

if USB

config USB_NRFX
	default y

config USB_DEVICE_STACK
	default y

endif # USB

config BT_CTLR
	default BT

config ZMK_BLE
	default y

config ZMK_USB
	default y

config ZMK_BATTERY_VOLTAGE_DIVIDER
	default y

if ZMK_DISPLAY

config I2C
	default y

config SSD1306
	default y

# config SSD1306_REVERSE_MODE
# 	default y

endif # ZMK_DISPLAY

if LVGL

config LV_Z_VDB_SIZE
	default 50

config LV_Z_BITS_PER_PIXEL
	default 1

choice LV_COLOR_DEPTH
	default LV_COLOR_DEPTH_1
endchoice

endif

source "/home/steven/gitproj/zmk/app/steno/Kconfig"

endif
```

## app/boards/arm/fissure/fissure_defconfig
```kconfig
# SPDX-License-Identifier: MIT

CONFIG_SOC_SERIES_NRF52X=y
CONFIG_SOC_NRF52840_QIAA=y

# Enable MPU
CONFIG_ARM_MPU=y

# enable GPIO
CONFIG_GPIO=y

CONFIG_USE_DT_CODE_PARTITION=y

CONFIG_MPU_ALLOW_FLASH_WRITE=y
CONFIG_NVS=y
CONFIG_SETTINGS_NVS=y
CONFIG_FLASH=y
CONFIG_FLASH_PAGE_LAYOUT=y
CONFIG_FLASH_MAP=y

# CONFIG_RING_BUFFER=y

# CONFIG_PWM=y
# CONFIG_SPI=y
# CONFIG_NRFX_SPIM0=y
# CONFIG_SPI_NOR=y

# CONFIG_I2C=y
# CONFIG_SSD1306=y

# CONFIG_NORDIC_QSPI_NOR=y

CONFIG_ZMK_DISPLAY=y
CONFIG_ZMK_WIDGET_BATTERY_STATUS=y
CONFIG_ZMK_WIDGET_OUTPUT_STATUS=y
CONFIG_ZMK_WIDGET_LAYER_STATUS=y
CONFIG_ZMK_WIDGET_WPM_STATUS=y

CONFIG_ZMK_USB_LOGGING=y
CONFIG_ZMK_WIDGET_WPM_STATUS=y
# CONFIG_ZMK_EMBEDDED_STENO=y
# CONFIG_ZMK_EMBEDDED_STENO_KEY_INTERVAL=3
# CONFIG_ZMK_EMBEDDED_STENO_NOUI=n
# CONFIG_ZMK_EMBEDDED_STENO_NOUNICODE=y
# CONFIG_ZMK_EMBEDDED_STENO_LOG_BACKEND_CONSOLE=y
# CONFIG_ZMK_EMBEDDED_STENO_DEBUG_HIST=y
# CONFIG_ZMK_EMBEDDED_STENO_READONLY=y

CONFIG_LOG_STRDUP_BUF_COUNT=32

# TODO move these back into Kconfig
CONFIG_ZMK_WIDGET_BATTERY_STATUS=y
CONFIG_ZMK_WIDGET_OUTPUT_STATUS=y
CONFIG_LVGL_USE_CONT=y
CONFIG_ZMK_DISPLAY_STATUS_SCREEN_BUILT_IN=n
CONFIG_ZMK_DISPLAY_STATUS_SCREEN_CUSTOM=y
```

## app/boards/arm/fissure/fissure_left_defconfig
```kconfig
# SPDX-License-Identifier: MIT
CONFIG_ZMK_SPLIT=y

CONFIG_SOC_SERIES_NRF52X=y
CONFIG_SOC_NRF52840_QIAA=y

# Enable MPU
CONFIG_ARM_MPU=y

# enable GPIO
CONFIG_GPIO=y

CONFIG_USE_DT_CODE_PARTITION=y

CONFIG_MPU_ALLOW_FLASH_WRITE=y
CONFIG_NVS=y
CONFIG_SETTINGS_NVS=y
CONFIG_FLASH=y
CONFIG_FLASH_PAGE_LAYOUT=y
CONFIG_FLASH_MAP=y

CONFIG_SPI=y
CONFIG_SPI_NOR=y

CONFIG_I2C=y
CONFIG_LED_STRIP=y
CONFIG_IS31FL3729=y

CONFIG_PINCTRL=y

CONFIG_CLOCK_CONTROL_NRF_K32SRC_RC=y
CONFIG_CLOCK_CONTROL_NRF_K32SRC_500PPM=y

# # CONFIG_ZMK_LOG_LEVEL_INF=y
# CONFIG_LOG=y
# CONFIG_CONSOLE=y
# CONFIG_USE_SEGGER_RTT=y
# CONFIG_RTT_CONSOLE=y
# CONFIG_UART_CONSOLE=n
# # CONFIG_ZMK_LOGGING_MINIMAL=y
# CONFIG_LOG_BUFFER_SIZE=8192

CONFIG_ZMK_IDLE_TIMEOUT=10000
CONFIG_ZMK_LED_WIDGETS=y
CONFIG_BT_BUF_ACL_TX_COUNT=32
CONFIG_ZMK_SPLIT_BLE_PERIPHERAL_STACK_SIZE=1024
# CONFIG_MPU_STACK_GUARD=y

CONFIG_BT_CTLR_TX_PWR_PLUS_8=y
```

## app/boards/arm/fissure/fissure_right_defconfig
```kconfig
# SPDX-License-Identifier: MIT
CONFIG_ZMK_SPLIT=y
CONFIG_ZMK_SPLIT_ROLE_CENTRAL=y

CONFIG_SOC_SERIES_NRF52X=y
CONFIG_SOC_NRF52840_QIAA=y

# Enable MPU
CONFIG_ARM_MPU=y

CONFIG_GPIO=y

CONFIG_USE_DT_CODE_PARTITION=y

CONFIG_MPU_ALLOW_FLASH_WRITE=y
CONFIG_NVS=y
CONFIG_SETTINGS_NVS=y
CONFIG_FLASH=y
CONFIG_FLASH_PAGE_LAYOUT=y
CONFIG_FLASH_MAP=y

CONFIG_SPI=y
CONFIG_SPI_NOR=y

CONFIG_ZMK_DISPLAY=n

CONFIG_I2C=y
CONFIG_LED_STRIP=y
CONFIG_IS31FL3729=y

CONFIG_ZMK_MOUSE=y
CONFIG_PMW3610=y
# CONFIG_PINNACLE=y
# CONFIG_PINNACLE_TRIGGER_GLOBAL_THREAD=y
CONFIG_ZMK_MOUSE_WORK_QUEUE_SYSTEM=y

CONFIG_PINCTRL=y
CONFIG_NFCT_PINS_AS_GPIOS=y

# # CONFIG_ZMK_LOG_LEVEL_INF=y
# CONFIG_LOG=y
# CONFIG_CONSOLE=y
# CONFIG_USE_SEGGER_RTT=y
# CONFIG_RTT_CONSOLE=y
# CONFIG_UART_CONSOLE=n
# CONFIG_LOG_BACKEND_RTT_OUTPUT_BUFFER_SIZE=128
# # CONFIG_ZMK_LOGGING_MINIMAL=y
# CONFIG_LOG_BUFFER_SIZE=8192

CONFIG_CLOCK_CONTROL_NRF_K32SRC_RC=y
CONFIG_CLOCK_CONTROL_NRF_K32SRC_500PPM=y

CONFIG_ZMK_EMBEDDED_STENO=y
CONFIG_ZMK_EMBEDDED_STENO_KEY_INTERVAL=3
CONFIG_ZMK_EMBEDDED_STENO_ENABLE_UI=n
# CONFIG_ZMK_EMBEDDED_UI_SCREEN_SMALL_OLED=y
CONFIG_ZMK_EMBEDDED_STENO_NOUNICODE=y
CONFIG_ZMK_EMBEDDED_STENO_LOG_BACKEND_CONSOLE=n
CONFIG_ZMK_EMBEDDED_STENO_DEBUG_HIST=n
CONFIG_ZMK_EMBEDDED_STENO_DICTEDIT=n
CONFIG_ZMK_BLE_KEYBOARD_REPORT_QUEUE_SIZE=256

CONFIG_ZMK_IDLE_TIMEOUT=10000
CONFIG_ZMK_SLEEP=y
CONFIG_ZMK_IDLE_SLEEP_TIMEOUT=600000
CONFIG_ZMK_LED_WIDGETS=y
CONFIG_MPU_STACK_GUARD=y

CONFIG_BT_CTLR_TX_PWR_PLUS_8=y
```

## app/module/drivers/sensor/Kconfig
```kconfig
# Copyright (c) 2020 The ZMK Contributors
# SPDX-License-Identifier: MIT

if SENSOR

rsource "battery/Kconfig"
rsource "ec11/Kconfig"
rsource "max17048/Kconfig"
rsource "pixart/pmw3610/Kconfig"
rsource "cirque_trackpad/Kconfig"

endif # SENSOR
```
